## esp_schedule/examples/get_started/main/Kconfig.projbuild
```kconfig
# Example project configuration for ESP Schedule

menu "esp_schedule Example Configuration"

    # Network provisioning scheme selection
    choice ESP_SCHEDULE_EXAMPLE_PROV_SCHEME
        prompt "Network Provisioning Scheme"
        default ESP_SCHEDULE_EXAMPLE_PROV_SOFTAP
        help
            Select the network provisioning scheme for the ESP Schedule example.
            For BLE provisioning, please enable BT_ENABLED and BT_NIMBLE_ENABLED.

    config ESP_SCHEDULE_EXAMPLE_PROV_BLE
        bool "BLE Provisioning"
        depends on BT_ENABLED && BT_NIMBLE_ENABLED
        help
            Use Bluetooth Low Energy (BLE) for network provisioning.
            Requires a BLE-capable device and provisioning app.

    config ESP_SCHEDULE_EXAMPLE_PROV_SOFTAP
        bool "SoftAP Provisioning"
        help
            Use WiFi Soft Access Point for network provisioning.
            Creates a WiFi hotspot that users can connect to for provisioning.

    endchoice

    config ESP_SCHEDULE_EXAMPLE_PROV_POP
        string "Proof of Possession (PoP)"
        default "12345678"
        help
            Proof of Possession value for secure network provisioning.
            This is used for authentication during the provisioning process.
            In production applications, use a unique, randomly generated value.

endmenu
```

## network_provisioning/examples/wifi_prov_ext_protocomm/main/Kconfig.projbuild
```kconfig
menu "Example Configuration"

    config EXAMPLE_PROV_TRANSPORT_BLE
        bool
        default y
        select BT_ENABLED
        depends on !IDF_TARGET_ESP32S2
        help
            This example uses BLE transport exclusively.

    config EXAMPLE_PROV_USING_BLUEDROID
        bool
        depends on (BT_BLUEDROID_ENABLED && (IDF_TARGET_ESP32C3 || IDF_TARGET_ESP32S3))
        select BT_BLE_42_FEATURES_SUPPORTED
        default y
        help
            This enables BLE 4.2 features for Bluedroid.

    config EXAMPLE_PROV_SHOW_QR
        bool "Show provisioning QR code on terminal"
        default y
        help
            Display the provisioning QR code as ASCII art on the serial terminal
            in addition to printing the URL.

    config EXAMPLE_BOOT_BUTTON_GPIO
        int "GPIO of the BOOT button"
        default 28 if IDF_TARGET_ESP32C5
        default 9 if IDF_TARGET_ESP32C3 || IDF_TARGET_ESP32C6 || IDF_TARGET_ESP32C2 || IDF_TARGET_ESP32H2
        default 0
        help
            The example pauses the session once the device joins the network.
            A press of this button toggles the session between paused and
            resumed. GPIO 0 is the BOOT button on most development boards.

    config EXAMPLE_RESET_PROVISIONED
        bool
        default n
        prompt "Reset provisioned status on each boot"
        help
            Erases NVS so provisioning runs on every boot. Useful for testing.

endmenu
```
